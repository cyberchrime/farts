## sw/build/conf/bblayers.conf
```bitbake
# POKY_BBLAYERS_CONF_VERSION is increased each time build/conf/bblayers.conf
# changes incompatibly
POKY_BBLAYERS_CONF_VERSION = "2"

BBPATH = "${TOPDIR}"
BBFILES ?= ""

BBLAYERS ?= " \
  ${TOPDIR}/../sources/poky/meta \
  ${TOPDIR}/../sources/poky/meta-poky \
  ${TOPDIR}/../sources/poky/meta-yocto-bsp \
  ${TOPDIR}/../sources/meta-xilinx-tools \
  ${TOPDIR}/../sources/meta-xilinx/meta-xilinx-core \
  ${TOPDIR}/../sources/meta-xilinx/meta-xilinx-standalone \
  ${TOPDIR}/../sources/meta-xilinx/meta-xilinx-bsp \
  ${TOPDIR}/../sources/meta-sniffer \
  ${TOPDIR}/../sources/meta-openembedded/meta-oe \
  "
```

## sw/sources/meta-sniffer/conf/distro/sniffer-distro.conf
```bitbake
DISTRO_NAME = "Sniffer"
DISTRO_VERSION = "1.0"

# Do not include the kernel in the generated root FS
RDEPENDS:${KERNEL_PACKAGE_NAME}-base = ""

#bootloader variables
EXTRA_IMAGEDEPENDS:append = " virtual/bootloader virtual/fsbl"
SPL_BINARY = ""
EXTRA_IMAGEDEPENDS:remove = "virtual/boot-bin "
IMAGE_INSTALL:append = " xilinx-bootbin"

#device-tree variables
YAML_CONSOLE_DEVICE_CONFIG:zedboard-zynq7:pn-device-tree = "ps7_uart_1"
YAML_MAIN_MEMORY_CONFIG:zedboard-zynq7:pn-device-tree = "PS7_DDR_0"
EXTRA_DT_FILES += ""
DT_PADDING_SIZE:pn-device-tree = "0x1000"
DTC_FLAGS:pn-device-tree += "-@"

#fsbl variables
compilerflags:pn-fsbl-firmware = ""
YAML_COMPILER_FLAGS:append:pn-fsbl-firmware = " ${compilerflags}"
YAML_SERIAL_CONSOLE_STDIN:zedboard-zynq7:pn-fsbl-firmware = "ps7_uart_1"
YAML_SERIAL_CONSOLE_STDOUT:zedboard-zynq7:pn-fsbl-firmware = "ps7_uart_1"

#Add Kernel image
KERNEL_IMAGETYPE = "zImage"
KERNEL_EXTRA_ARGS:append = " UIMAGE_LOADADDR=0x200000"
KERNEL_ALT_IMAGETYPE = "uImage"

#Add FIT Variables
KERNEL_CLASSES:append = " kernel-fitimage"
KERNEL_IMAGETYPES:append = " fitImage vmlinux"
UBOOT_ENTRYPOINT  = "0x200000"
UBOOT_LOADADDRESS = "0x200000"

#Add extlinux Variables
UBOOT_EXTLINUX = "1"
UBOOT_EXTLINUX_FDT = "../system.dtb"
UBOOT_EXTLINUX_CONSOLE = "console=ttyPS0,${baudrate}"
UBOOT_EXTLINUX_ROOT = "root=/dev/mmcblk0p2"
UBOOT_EXTLINUX_KERNEL_ARGS:append = " earlycon clk_ignore_unused"

#Add distro variables
# TODO: set INITRAMFS IMAGE
INITRAMFS_IMAGE = "core-image-minimal"
#INITRAMFS_IMAGE = "${DISTRO}"
IMAGE_FSTYPES:zynq = "cpio cpio.gz cpio.gz.u-boot ext4 tar.gz jffs2"
SERIAL_CONSOLES = "115200;ttyPS0"
SERIAL_CONSOLES_CHECK = "${SERIAL_CONSOLES}"
YAML_SERIAL_CONSOLE_BAUDRATE = "115200"

# deploy class variables
PACKAGE_DTB_NAME = ""
PACKAGE_FITIMG_NAME = "fitImage"


#Rootfs configs
IMAGE_AUTOLOGIN = "1"
#EXTRA_USERS_PARAMS ?= "usermod -P root root;useradd -P sniffer sniffer;"
IMAGE_INSTALL:append += "\
	packagegroup-core-ssh-openssh \
	openssh-sftp-server \
	rpm \
	mdio-tools \
	openssl \
        header"
MACHINE_ESSENTIAL_EXTRA_RDEPENDS += "kernel-module-sniffer"
```

## sw/sources/meta-sniffer/conf/layer.conf
```bitbake
# We have a conf and classes directory, add to BBPATH
BBPATH .= ":${LAYERDIR}"

# We have recipes-* directories, add to BBFILES
BBFILES += "${LAYERDIR}/recipes-*/*/*.bb \
            ${LAYERDIR}/recipes-*/*/*.bbappend"

BBFILE_COLLECTIONS += "sniffer"
BBFILE_PATTERN_sniffer = "^${LAYERDIR}/"
BBFILE_PRIORITY_sniffer = "9"

LAYERDEPENDS_sniffer = "xilinx-tools"
LAYERSERIES_COMPAT_sniffer = "honister"

DEPENDS = "virtual/kernel"

PREFERRED_VERSION_linux-yocto = "5.10%"
```
